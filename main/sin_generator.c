#include "sin_generator.h"
#include "esp_check.h"
#include "driver/dac_common.h"
#include "math.h"
#include "esp_rom_sys.h"
#include "driver/timer.h"

//double[256] amplitude = 0.000000000, 0.003921569, 0.007843137, 0.011764706, 0.015686275, 0.019607843, 0.023529412, 0.027450980, 0.031372549, 0.035294118, 0.039215686, 0.043137255, 0.047058824,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 0.996078431, 1.000000000;

//double[256] t = 0.000000000, 0.000624139, 0.001248287, 0.001872454, 0.002496651, 0.003120885, 0.003745168, 0.004369508, 0.004993916, 0.005618400, 0.006242971, 0.006867638, 0.007492411,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 0.235900391, 0.250000000;
static const char *TAG = "sin generator";
const double time_per_tick = 0.000000025;
//double amp[256] = {-1.000000000, -0.992187500, -0.984375000, -0.976562500, -0.968750000, -0.960937500, -0.953125000, -0.945312500, -0.937500000, -0.929687500, -0.921875000, -0.914062500, -0.906250000,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 0.984375000, 0.992187500};
//double t[256] = {-0.250000000, -0.230092657, -0.221828352, -0.215474286, -0.210106912, -0.205368745, -0.201076558, -0.197121574, -0.193432959, -0.189961540, -0.186671533, -0.183535940, -0.180533797,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 0.221828352, 0.230092657};
//double t[128] = {0.001243411, 0.002486897, 0.003730536, 0.004974402, 0.006218572, 0.007463123, 0.008708130, 0.009953671, 0.011199823, 0.012446663, 0.013694269, 0.014942719, 0.016192092,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 0.230092657, 0.250000000};
double t[128] = { 0.0012434106, 0.0012434865, 0.0012436384, 0.0012438663, 0.0012441703, 0.0012445506, 0.0012450075, 0.0012455412, 0.0012461519, 0.0012468400, 0.0012476060, 0.0012484501, 0.0012493730,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 0.0082643055, 0.0199073428 };
dac_channel_t current_channel;
double current_freq;
int16_t i;
int16_t current_amp;
uint64_t next_alarm_value;
extern int max_amp;
void IRAM_ATTR timer_update_dac(void *arg) {
    //printf("interupted!\n");
    //dac_output_voltage(current_channel, current_amp);
    dac_output_voltage(current_channel, current_amp);
    timer_group_clr_intr_status_in_isr(TIMER_GROUP_0, TIMER_0);
    /*
    current_amp++;
    if (current_amp >= 256) {
        current_amp = 0;
    }
    */
    
    if (i >= 0 && i < 128) {
        //next_alarm_value = round(t[i + 1] - t[i] / current_freq / 0.000000025);
        next_alarm_value = round(t[i] / current_freq / time_per_tick);
        current_amp++;
        if (current_amp > max_amp) {
            max_amp = current_amp;
        }

        
        if (current_amp > 255) {
            current_amp = 255;
        }
        
    } else if (i >= 128 && i < 256) {
        //next_alarm_value = round(t[128 - i + 1] - t[128 - i] / current_freq / 0.000000025);
        next_alarm_value = round(t[255 - i] / current_freq / time_per_tick); //127 - (i - 128) = 255 - i
        current_amp--;
    } else if (i >= 256 && i < 256 + 128) {
        //next_alarm_value = round(t[256 - i + 1] - t[256 - i] / current_freq / 0.000000025);
        next_alarm_value = round(t[i - 256] / current_freq / time_per_tick); //i - 256
        current_amp--;
        if (current_amp < 0) {
            current_amp = 0;
        }
    } else if (i >= 256 + 128 && i < 512) {
        //next_alarm_value = round(t[512 - i + 1] - t[512 - i] / current_freq / 0.000000025);
        next_alarm_value = round(t[511 - i] / current_freq / time_per_tick); // 127 - (i - 256 - 128) = 511 - i
        current_amp++;
    }

    i++;
    if (i >= 512) {
        i = 0;
    }
    
    
    /*
    if (current_amp != 0) {
        current_amp = 0;
        next_alarm_value = 8000;
    } else {
        current_amp = 128;
        next_alarm_value = 2000;
    }
    */
    //next_alarm_value = abs(t[current_amp] - t[current_amp - 1]);
    //next_alarm_value = current_amp * 10;
    //timer_set_alarm_value(TIMER_GROUP_0, TIMER_0, next_alarm_value);
    timer_set_alarm_value(TIMER_GROUP_0, TIMER_0, next_alarm_value);
    timer_group_enable_alarm_in_isr(TIMER_GROUP_0, TIMER_0);
}

//支持相位调节的延时器版本
//相位从负到正，------- 2表示2*pi,1表示pi,0.5表示1/2*pi,0表示0*pi ------- 最终被转化为0至2*pi
//相位的单位为弧度
esp_err_t sin_wave_start(dac_channel_t channel, double freq, double phase) {
    ESP_RETURN_ON_FALSE(channel < DAC_CHANNEL_MAX, ESP_ERR_INVALID_ARG, TAG, "DAC channel error");
    max_amp = 0;
    current_channel = channel;
    current_freq = freq;
    
    dac_output_enable(current_channel);
    /*
    dac_output_voltage(current_channel, 112);
    esp_rom_delay_us(1000 * 100);
    dac_output_voltage(current_channel, 10);
    esp_rom_delay_us(1000 * 10);
    */
    //phase = phase % (2.0 * pi);
    phase = fmod(phase, 2.0 * pi);
    printf("phase is : %09f\n", phase);
    //将负相位转化为正相位
    if (phase < 0.0) {
        phase += 2.0 * pi;
    }
    printf("positive phase is : %09f\n", phase);
    double v = sin(phase);
    printf("v is : %09f\n", v);//v范围为-1,1
    v = v * 128.0 + 128.0;//转化到0至256.0区间
    i = floor(v);
    if (i >= 256) {
        current_amp = 255;
    } else {
        current_amp = i;
    }
    printf("current_amp is : %d\n", i);
    if (phase >= 0.0 && phase < 0.5 * pi) {
        i = i - 128;
    } else if (phase >= 0.5 * pi && phase < pi) {
        i = 256 - i + 128;
    } else if (phase >= pi && phase < 1.5 * pi) {
        i = 128 - i + 256;
    } else if (phase >= 1.5 * pi && phase < 2.0 * pi) {
        i = 512 - (128 - i);
    }
    printf("i is : %d\n", i);
    timer_config_t timer_config = {
        .divider = 2,//2分频，APB时钟为80Mhz，2分频后周期为25ns
        .counter_dir = TIMER_COUNT_UP,//向上计数
        .counter_en = TIMER_PAUSE,//等待手动开启
        .alarm_en = TIMER_ALARM_EN,//计数到达终点报警中断
        .auto_reload = TIMER_AUTORELOAD_EN,//自动重装重新计时
        .intr_type = TIMER_INTR_LEVEL,//电平中断
    };
    
    //next_alarm_value = 0;
    next_alarm_value = 40 * 1000 * 5;//5ms延时后输出第一个数据
    //current_amp = 128;
    esp_err_t result;
    result = timer_init(TIMER_GROUP_0, TIMER_0, &timer_config);
    if (result == ESP_OK) {
        //printf("timer_init ok!\n");
    } else {
        printf("timer_init failed!!!\n");
    }
    result = timer_set_counter_value(TIMER_GROUP_0, TIMER_0, 0x00000000ULL);
    if (result == ESP_OK) {
        //printf("timer_set_counter_value ok!\n");
    } else {
        printf("timer_set_counter_value failed!!!\n");
        ESP_RETURN_ON_ERROR(result, TAG, "timer_set_counter_value failed!!!\n");
    }
    result = timer_set_alarm_value(TIMER_GROUP_0, TIMER_0, next_alarm_value);
    if (result == ESP_OK) {
        //printf("timer_set_alarm_value ok!\n");
    } else {
        printf("timer_set_alarm_value failed!!!\n");
        ESP_RETURN_ON_ERROR(result, TAG, "timer_set_alarm_value failed!!!\n");
    }
    result = timer_enable_intr(TIMER_GROUP_0, TIMER_0);
    if (result == ESP_OK) {
        //printf("timer_enable_intr ok!\n");
    } else {
        printf("timer_enable_intr failed!!!\n");
        ESP_RETURN_ON_ERROR(result, TAG, "timer_enable_intr failed!!!\n");
    }
    //result = timer_isr_register(TIMER_GROUP_0, TIMER_0, &timer_update_dac, NULL, ESP_INTR_FLAG_SHARED, NULL);
    result = timer_isr_register(TIMER_GROUP_0, TIMER_0, &timer_update_dac, NULL, ESP_INTR_FLAG_IRAM, NULL);
    if (result == ESP_OK) {
        //printf("timer_isr_register ok!\n");
    } else {
        printf("timer_isr_register failed!!!\n");
        ESP_RETURN_ON_ERROR(result, TAG, "timer_isr_register failed!!!\n");
    }
    result = timer_start(TIMER_GROUP_0, TIMER_0);
    if (result == ESP_OK) {
        printf("timer_start ok!\n");
    } else {
        printf("timer_start failed!!!\n");
        ESP_RETURN_ON_ERROR(result, TAG, "timer_start failed!!!\n");
    }
    return ESP_OK;
}

//不完美的软件延时版本

esp_err_t sin_wave(dac_channel_t channel, double freq) {
    int t1[256];
    ESP_RETURN_ON_FALSE(channel < DAC_CHANNEL_MAX, ESP_ERR_INVALID_ARG, TAG, "DAC channel error");
    for (int i = 0; i < 256; i++) {
        double t2 = t[i] / freq;
        t1[i] = round(t2 * 1000000); //精确到us
    }
    dac_output_enable(channel);
    while (true) {
        for (int i = 0; i < 255; i++) {
            dac_output_voltage(channel, i);
            esp_rom_delay_us(t1[i + 1] - t1[i]);
        }
    
        for (int i = 255; i > 0; i--) {
            dac_output_voltage(channel, i);
            esp_rom_delay_us(t1[i] - t1[i - 1]);
        }
    }
    

    return ESP_OK;
}
